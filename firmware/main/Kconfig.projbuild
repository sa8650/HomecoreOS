## firmware/main/Kconfig.projbuild
```kconfig
menu "HomecoreOS Board & Build Configuration"

config HOMECORE_FW_VERSION
    string "HomecoreOS Firmware Version"
    default "1.2.0"
    help
        Semantic firmware version embedded into device heartbeats, pairing, and MQTT status.

config HOMECORE_BOARD_SLUG
    string "Target Board Library Profile Slug"
    default "esp32-s3-devkitc-1-n16r8"
    help
        Board Library profile slug identifying exact hardware pinout, flash, and PSRAM layout.

config HOMECORE_PARTITION_SCHEME
    string "Partition Scheme Identifier"
    default "dual_ota_16mb"
    help
        Partition table identifier matching the selected partitions CSV.

config HOMECORE_BOOT_BUTTON_GPIO
    int "BOOT / Recovery Button GPIO"
    range 0 48
    default 28 if IDF_TARGET_ESP32C5
    default 9 if IDF_TARGET_ESP32C2 || IDF_TARGET_ESP32C3 || IDF_TARGET_ESP32C6 || IDF_TARGET_ESP32C61 || IDF_TARGET_ESP32H2
    default 0
    help
        Active-low BOOT / Recovery GPIO pin on this development board.

config HOMECORE_ROLE_DEFAULT
    string "Default role before the console assigns one"
    default "controller"
    help
        Every device that never received a role from the web console runs as a
        Controller, which is how the firmware behaved before the unified
        Controller/Node release. A role delivered in the config snapshot and
        persisted in NVS always wins, and a 10s BOOT factory reset erases it.

config HOMECORE_ESPNOW_CHANNEL
    int "Default ESP-NOW channel (0 = follow the Wi-Fi channel)"
    range 0 13
    default 0
    help
        0 keeps ESP-NOW on the channel of the AP the device is associated with,
        which is the only correct choice for a Controller behind a router. A
        Node with 0 searches all channels until its Controller answers. Pin a
        channel only for installations with a fixed, non-overlapping setup.

config HOMECORE_FLASH_SIZE_MB
    int "Target SPI Flash Size (MB)"
    range 2 64
    default 16 if IDF_TARGET_ESP32S3
    default 8 if IDF_TARGET_ESP32C5 || IDF_TARGET_ESP32C6 || IDF_TARGET_ESP32C61
    default 4
    help
        Configured flash chip capacity in megabytes.

config HOMECORE_PSRAM_SIZE_MB
    int "Target PSRAM Size (MB)"
    range 0 32
    default 8 if IDF_TARGET_ESP32S3 || IDF_TARGET_ESP32C5
    default 2 if IDF_TARGET_ESP32S2 || IDF_TARGET_ESP32C61
    default 0
    help
        Configured external PSRAM capacity in megabytes (0 if none).

menu "HomecoreOS Sensor Drivers"

config HOMECORE_I2C_DEFAULT_SDA_GPIO
    int "Default I2C SDA GPIO (-1 if unavailable)"
    range -1 48
    default 1 if IDF_TARGET_ESP32S3 || IDF_TARGET_ESP32S2
    default 0 if IDF_TARGET_ESP32C2 || IDF_TARGET_ESP32C3 || IDF_TARGET_ESP32C5 || IDF_TARGET_ESP32C6 || IDF_TARGET_ESP32C61 || IDF_TARGET_ESP32H2
    default 21
    help
        Board default I2C SDA GPIO pin used when an I2C sensor binds to the board default bus.

config HOMECORE_I2C_DEFAULT_SCL_GPIO
    int "Default I2C SCL GPIO (-1 if unavailable)"
    range -1 48
    default 2 if IDF_TARGET_ESP32S3 || IDF_TARGET_ESP32S2
    default 1 if IDF_TARGET_ESP32C2 || IDF_TARGET_ESP32C3 || IDF_TARGET_ESP32C5 || IDF_TARGET_ESP32C6 || IDF_TARGET_ESP32C61 || IDF_TARGET_ESP32H2
    default 22
    help
        Board default I2C SCL GPIO pin used when an I2C sensor binds to the board default bus.

config HOMECORE_DRIVER_DHT22
    bool "Enable DHT22 / AM2302 Temperature & Humidity Driver"
    default y
    help
        Compile the single-wire DHT22/AM2302 sensor driver into this firmware image.

config HOMECORE_DRIVER_DS18B20
    bool "Enable DS18B20 1-Wire Temperature Driver"
    default y
    help
        Compile the Dallas 1-Wire DS18B20 temperature sensor driver into this firmware image.

config HOMECORE_DRIVER_BME280
    bool "Enable BME280 I2C Environmental Driver"
    default y
    help
        Compile the Bosch BME280 I2C temperature, humidity, and barometric pressure driver.

config HOMECORE_DRIVER_PIR
    bool "Enable Digital PIR Motion Driver"
    default y
    help
        Compile the digital GPIO PIR motion sensor driver.

config HOMECORE_DRIVER_REED
    bool "Enable Magnetic Reed Contact Switch Driver"
    default y
    help
        Compile the magnetic reed door/window contact switch driver.

config HOMECORE_DRIVER_BH1750
    bool "Enable BH1750 I2C Ambient Light Driver"
    default y
    help
        Compile the ROHM BH1750 I2C ambient light (lux) driver.

config HOMECORE_DRIVER_ADC_VOLTAGE
    bool "Enable Calibrated ADC Voltage Driver"
    default y
    help
        Compile the calibrated ESP-IDF ADC oneshot voltage measurement driver.

config HOMECORE_DRIVER_DHT11
    bool "Enable DHT11 Single-Wire Driver"
    default n
    help
        Compile the shared DHT single-wire protocol with DHT11 integer decoding.

config HOMECORE_DRIVER_SHT3X
    bool "Enable SHT3x I2C Driver (SHT30/31/35)"
    default n
    help
        Compile the SHT3x I2C temperature/humidity family with CRC-8 validation.

config HOMECORE_DRIVER_AHT20
    bool "Enable AHT20 I2C Driver"
    default n
    help
        Compile the AHT20 I2C temperature/humidity driver.

config HOMECORE_DRIVER_TMP117
    bool "Enable TMP117 Precision I2C Temperature Driver"
    default n
    help
        Compile the TMP117 I2C precision temperature driver.

config HOMECORE_DRIVER_LD2410
    bool "Enable LD2410 UART Presence Driver"
    default n
    help
        Compile the LD2410 UART mmWave presence/motion/distance driver (UART1).

config HOMECORE_DRIVER_LD2450
    bool "Enable LD2450 Driver (planned, no implementation)"
    default n
    help
        Reserved only. The LD2450 protocol is not implemented; do not enable.

config HOMECORE_DRIVER_VEML7700
    bool "Enable VEML7700 Ambient Light Driver"
    default n
    help
        Compile the VEML7700 I2C ambient light driver.

config HOMECORE_DRIVER_SGP30
    bool "Enable SGP30 Air Quality Driver"
    default n
    help
        Compile the SGP30 TVOC/eCO2 I2C driver. eCO2 is an estimate, not calibrated CO2.

config HOMECORE_DRIVER_WATER_LEAK
    bool "Enable Water Leak GPIO Driver"
    default n
    help
        Compile the GPIO water-leak contact driver.

config HOMECORE_DRIVER_WATER_LEVEL
    bool "Enable Analog Water Level Driver"
    default n
    help
        Compile the ADC water-level driver. Requires in-place calibration.

config HOMECORE_DRIVER_SOIL_MOISTURE
    bool "Enable Capacitive Soil Moisture Driver"
    default n
    help
        Compile the ADC capacitive soil-moisture driver.

config HOMECORE_DRIVER_RAIN
    bool "Enable Rain Detection GPIO Driver"
    default n
    help
        Compile the comparator rain-sensor digital input driver.

config HOMECORE_DRIVER_INA219
    bool "Enable INA219 I2C Power Monitor Driver"
    default n
    help
        Compile the INA219 bus voltage / current / power driver.

config HOMECORE_DRIVER_INA226
    bool "Enable INA226 I2C Power Monitor Driver"
    default n
    help
        Compile the INA226 voltage / current / power / estimated energy driver.

config HOMECORE_DRIVER_PZEM004T
    bool "Enable PZEM-004T Driver (planned, no implementation)"
    default n
    help
        Reserved only. PZEM-004T UART metering is not implemented.

config HOMECORE_DRIVER_SCT013
    bool "Enable SCT-013 ADC Driver (planned, no implementation)"
    default n
    help
        Reserved only. Burden/bias external conditioning is not implemented.

config HOMECORE_DRIVER_MQ2
    bool "Enable MQ-2 Qualitative ADC Driver"
    default n
    help
        Compile qualitative MQ-2 ADC sampling. Not a gas or fire safety alarm.

config HOMECORE_DRIVER_MQ135
    bool "Enable MQ-135 Qualitative ADC Driver"
    default n
    help
        Compile qualitative MQ-135 ADC sampling. Not an air-safety alarm.

endmenu

endmenu
```
